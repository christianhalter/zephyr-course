## boards/copied_board/board.yml
```yaml
board:
  name: copied_board
  full_name: Raspberry Pi Pico
  vendor: raspberrypi
  socs:
    - name: rp2040
      variants:
        - name: w
          variants:
            - name: mcuboot
        - name: mcuboot
```

## boards/scratch_board/board.yml
```yaml
board:
  name: scratch_board
  full_name: Board from Scratch
  vendor: raspberrypi
  socs:
    - name: rp2040
```

## drivers/led-switch-module/drivers/led_switch/KConfig
```kconfig
config LED_SWITCH
    bool "Custom LED switch"
    default y
    depends on DT_HAS_LED_SWITCH_ENABLED
    help
        Enable custom LED switch driver
```

## drivers/led-switch-module/dts/bindings/driver/led,switch.yaml
```yaml
description: Led switch using sensor properties
compatible: "led,switch"
include: [sensor-device.yaml, base.yaml]

properties:
  gpios:
    type: phandle-array
    required: true
    description: GPIO pin for the LED switch
    
```
