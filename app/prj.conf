## CMakeLists.txt
```
cmake_minimum_required(VERSION 3.20.0)

list(APPEND BOARD_ROOT ${CMAKE_CURRENT_SOURCE_DIR}/..)
list(APPEND EXTRA_ZEPHYR_MODULES ${CMAKE_CURRENT_SOURCE_DIR}/../drivers/led-switch-module)
find_package(Zephyr REQUIRED HINTS $ENV{ZEPHYR_BASE})
project(my_zephyr_app)

target_sources(app PRIVATE src/main.cpp)
```

## Kconfig
```
menuconfig LED_SUBSYSTEM
    bool "LED Subsystem"
    default y

if LED_SUBSYSTEM

    choice
        prompt "LED blink sleep time"
        default BLINK_PERIOD_1000MS
    
    config BLINK_PERIOD_2000MS
        bool "2s (high)"

    config BLINK_PERIOD_1000MS
        bool "1s (medium)"

    config BLINK_PERIOD_500MS
        bool "500ms (normal)"

    config BLINK_PERIOD_250MS
        bool "250ms (short)"

    endchoice

    config LED_BLINKING_PERIOD
        int
        default 250 if BLINK_PERIOD_250MS
        default 1000 if BLINK_PERIOD_1000MS
        default 500 if BLINK_PERIOD_500MS
        default 2000 if BLINK_PERIOD_2000MS
        default 1000
        range 100 5000
        help
            Blinking period
    
    menuconfig ADVANCED_LED_SETTINGS
    bool "Advanced LED Settings"

    if ADVANCED_LED_SETTINGS

        config LED_BRIGHTNESS
            int "LED brightness (0-100)"
            default 100
            range 0 100

        config LED_FADE_DURATION
            int "LED fade duration (ms)"
            default 500
            range 0 5000

        menu "Expert settings"
            visible if EXPERT_LED_SETTINGS

            config LED_DEBUG
                bool "Enable LED debugging"

            config CUSTOM_PATTERN
                bool "Custom blink pattern"

        endmenu # Expert settings

    endif # ADVANCED_LED_SETTINGS

endif # LED_SUBSYSTEM

config EXPERT_LED_SETTINGS
    bool
    default y

config APP_HEARTBEAT_PERIOD_MS
    int "App Heartbeat Period (ms)"
    default 500
    range 100 2000

menu "Zephyr Configuration"

source "Kconfig.zephyr"

endmenu


menu "Drivers Configuration"

rsource "../drivers/led-switch-module/Kconfig"

endmenu
```

## prj.conf
```kconfig
CONFIG_GPIO=y
CONFIG_LOG=y
CONFIG_SENSOR=y
CONFIG_LED_SWITCH=y
CONFIG_SHELL=y

#CONFIG_LED_BLINKING_PERIOD=500
#CONFIG_BLINK_PERIOD_500MS=y
```

## app.overlay
```dts
/{
    aliases {
        app-led = &led0;
        led-switch = &led_switch0;
    };

    led_switch0: led_switch {
        compatible = "led,switch";
        gpios = <&gpio0 25 GPIO_ACTIVE_HIGH>;
        status = "okay";
    };
};

&led0 {
    status = "disabled";
};
```

## src/main.cpp
```c
#include <zephyr/drivers/gpio.h>
#include <zephyr/kernel.h>
#include <zephyr/logging/log.h>
#include <zephyr/shell/shell.h>

#include <led_switch/led_switch.h>

#define SLEEP_TIME_MS CONFIG_APP_HEARTBEAT_PERIOD_MS

/* The devicetree node identifier for the "led_switch" alias. */
#define LED_SWITCH_NODE DT_ALIAS(led_switch)

static const struct device *const led_switch = DEVICE_DT_GET(LED_SWITCH_NODE);

LOG_MODULE_REGISTER(main, LOG_LEVEL_INF);

static int cmd_info(const struct shell *sh, size_t argc, char **argv)
{
    ARG_UNUSED(argc);
    ARG_UNUSED(argv);
    if (!device_is_ready(led_switch))
    {
        shell_error(sh, "LED Switch is not ready");
    }
    else
    {
        shell_print(sh, "LED Switch is ready");
    }
    return 0;
}

static int cmd_fetch(const struct shell *sh, size_t argc, char **argv)
{
    ARG_UNUSED(argc);
    ARG_UNUSED(argv);
    if (sensor_sample_fetch(led_switch)<0)
    {
        shell_error(sh, "Sample fetch - LED OFF - failed");
    }
    return 0;
}

static sensor_value cmd_read(const struct shell *sh, size_t argc, char **argv)
{
    ARG_UNUSED(argc);
    ARG_UNUSED(argv);
    struct sensor_value value;
    if (sensor_channel_get(led_switch, SENSOR_CHAN_ALL, &value)<0)
    {
        shell_error(sh, "Channel get - LED ON - failed");
    }
    return value;
}

int main(void)
{
    bool led_state = true;
    struct sensor_value value;

    if (!device_is_ready(led_switch))
    {
        LOG_ERR("LED Switch is not ready");
        return 0;
    }

    while (1) {
/*
        if (led_state)
        {
            if (sensor_sample_fetch(led_switch)<0)
            {
                LOG_ERR("Sample fetch - LED OFF - failed");
                return 0;
            }
            else
            {
                led_state = false;
            }
        }
        else
        {
            if (sensor_channel_get(led_switch, SENSOR_CHAN_ALL, &value))
            {
                LOG_ERR("Channel get - LED ON - failed");
                return 0;
            }
            else
            {
                led_state = true;
            }
        }

        LOG_INF("LED state: %s", led_state ? "ON" : "OFF");
*/
        k_msleep(SLEEP_TIME_MS);
    }
    return 0;
}

SHELL_STATIC_SUBCMD_SET_CREATE(
    sub_sensor,
    SHELL_CMD(fetch, NULL, "Turn LED OFF", cmd_fetch),
    SHELL_CMD(read, NULL, "Turn LED ON and print result", cmd_read),
    SHELL_CMD(info, NULL, "Print device name and ready state", cmd_info),
    SHELL_SUBCMD_SET_END);

SHELL_CMD_REGISTER(sensor, &sub_sensor, "Sensor commands", NULL);
```
